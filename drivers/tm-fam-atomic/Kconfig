## drivers/tm-fam-atomic/Kconfig
```kconfig
config FAM_ATOMIC
	tristate "FAM_ATOMIC - The Machine FAM atomic support"
	depends on TMFS
	default m
	help
	  Enable this to support using FAM atomic operations on
	  The Machine. This module is used by the libfam-atomic
	  userspace library.
```

## drivers/tm-flush/Kconfig
```kconfig
config FLUSHTM
  tristate "FLUSHTM - Driver to flush cache on The Machine"
  default m
  help
    Needed bt The Machine to flush and persist memory
```

## drivers/tm-fuse/Kconfig
```kconfig
config TMFS
	tristate "TMFS - The Machine Librarian File System support"
	depends on ZBRIDGE && FLUSHTM
	default m
	help
	  In order to run the Librarian File System (LFS) client answer Y or M.

config TM_MFT
	bool "TM_MFT - The Machine Librarian File System support"
	depends on TMFS
	default y
	help
	  Compile tmfs driver with zbridge and flushtm support answer Y or N.
```

## drivers/tm-zbridge/Kconfig
```kconfig
config ZBRIDGE
  tristate "ZBRIDGE - The zbridge driver"
  default m
  help
    Needed by The Machine to interact with the memory fabric
```
